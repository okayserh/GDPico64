/**
 * cas.c
 *
 * Functions for the CAS interface board. (I.e. in
 * essence a 6850 UART Chip)
 *
 * Copyright (C) 2024  Oliver Kayser-Herold
 *
 * This program is free software; you can redistribute it and/or
 * modify it under the terms of the GNU General Public License
 * as published by the Free Software Foundation; either version 2
 * of the License, or (at your option) any later version.
 *
 * This program is distributed in the hope that it will be useful,
 * but WITHOUT ANY WARRANTY; without even the implied warranty of
 * MERCHANTABILITY or FITNESS FOR A PARTICULAR PURPOSE.  See the
 * GNU General Public License for more details.
 *
 * You should have received a copy of the GNU General Public License
 * along with this program; if not, write to the Free Software
 * Foundation, Inc., 51 Franklin Street, Fifth Floor, Boston, MA  02110-1301, USA.
 *
 * SPDX-License-Identifier: GPL-2.0-or-later
 */

#include <stdio.h>
#include "xmodem_pico.h"
#include "par_bus.h"

#include "cas.h"

#define CAS_QUEUE_LENGTH 4
StaticQueue_t cas_queue_buf;
QueueHandle_t cas_queue;
uint8_t ucCASQueueStorage[CAS_QUEUE_LENGTH * PBUS_QUEUE_IS];
TaskHandle_t cas_task;


/****************************************************************************
 * Name: cas_proc_task
 *
 * Description:
 *   Task to process events generated by the (emulated) CAS interface.
 *   It reads and writes to the xmodem buffer.
 *
 * Input Parameters:
 *   unused_arg - Unused
 *
 * Returned Value:
 *   None
 *
 ****************************************************************************/

void cas_proc_task(void* unused_arg) {
  uint32_t fifo_cmd;
  uint8_t reg;

  while (1)
    {
      // Process queue
      if (xQueueReceive (cas_queue, &fifo_cmd, (TickType_t) 1))
	{
	  reg = (fifo_cmd >> 8) & 0xFF;
	  if (reg == 0xCB)
	    {
	      xmod_buffer[xmod_len++] = (uint8_t) fifo_cmd & 0xFF;
	      change_io_reg (0xCA, 0x2, 0x0);
	    }
	}

      // Transfer new data to CAS port when
      // flag indicates data had been read
      if ((read_io_reg (0xCA) & 0x1) == 0)
	{
	  write_io_reg (0xCC, xmod_buffer[xmod_len++]);
	  change_io_reg (0xCA, 0x1, 0x0);
	}
    }
}

/****************************************************************************
 * Name: init_cas
 *
 * Description:
 *   Initializes the CAS interface. Setup of a queue to receive
 *   events from the parallel bus and start of task to receive
 *   and send bytes from the xmodem buffer.
 *
 * Input Parameters:
 *   None
 *
 * Returned Value:
 *   None
 *
 ****************************************************************************/

void init_cas ()
{
    // Initialize queue and task for processing GDP commands
  cas_queue = xQueueGenericCreateStatic(CAS_QUEUE_LENGTH,
					PBUS_QUEUE_IS,
					&(ucCASQueueStorage[0]),
					&cas_queue_buf,
					queueQUEUE_TYPE_BASE);

  BaseType_t cas_status = xTaskCreate(cas_proc_task,
				      "CAS_TASK",
				      512,
				      NULL,
				      1,
				      &cas_task);
}
